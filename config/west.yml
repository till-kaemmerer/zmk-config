## config/west.yml
```yaml
manifest:
  remotes:
    - name: zmkfirmware
      url-base: https://github.com/zmkfirmware
    # Additional modules containing boards/shields/custom code can be listed here as well
    # See https://docs.zephyrproject.org/3.2.0/develop/west/manifest.html#projects
    # nice_oled
    - name: mctechnology17
      url-base: https://github.com/mctechnology17
    - name: zmk-locales
      url-base: https://github.com/joelspadin
  projects:
    - name: zmk
      remote: zmkfirmware
      revision: main
      import: app/west.yml
    # nice_oled
    - name: zmk-nice-oled
      remote: mctechnology17
      revision: main
    - name: zmk-locales
      remote: zmk-locales
      revision: main
  self:
    path: config
```
